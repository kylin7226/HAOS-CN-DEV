## buildroot-external/Config.in
```kconfig
source "$BR2_EXTERNAL_HASSOS_PATH/package/ap6256-firmware/Config.in"
source "$BR2_EXTERNAL_HASSOS_PATH/package/rknpu-driver/Config.in"
source "$BR2_EXTERNAL_HASSOS_PATH/package/rockchip-blobs/Config.in"
```
